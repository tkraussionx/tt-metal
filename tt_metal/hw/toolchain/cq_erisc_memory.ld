/* SPDX-FileCopyrightText: © 2023 Tenstorrent Inc.
 * SPDX-License-Identifier: Apache-2.0
 *
 */

MEMORY
{
    ERISC_LOCAL_DATA_MEM : ORIGIN = MEM_LOCAL_BASE, LENGTH = MEM_ERISC_LOCAL_SIZE - MEM_ERISC_STACK_SIZE
    ERISC_STACK_MEM : ORIGIN = MEM_ERISC_STACK_BASE, LENGTH = MEM_ERISC_STACK_SIZE
    ERISC_CODE : ORIGIN = MEM_ERISC_FIRMWARE_BASE, LENGTH = MEM_ERISC_FIRMWARE_SIZE
}
